## conf/bblayers.conf
```bitbake
# POKY_BBLAYERS_CONF_VERSION is increased each time build/conf/bblayers.conf
# changes incompatibly
POKY_BBLAYERS_CONF_VERSION = "2"

BBPATH = "${TOPDIR}"
BBFILES ?= ""

BBLAYERS ?= " \
  /home/kun/poky/meta \
  /home/kun/poky/meta-poky \
  /home/kun/poky/meta-yocto-bsp \
  /home/kun/poky/meta-raspberrypi \
  /home/kun/poky/meta-myconfig \
  /home/kun/poky/meta-openembedded/meta-oe \
  /home/kun/poky/meta-openembedded/meta-python \
  /home/kun/poky/meta-openembedded/meta-networking \
  /home/kun/poky/meta-openembedded/meta-multimedia \
  "
```

## meta-myconfig/conf/layer.conf
```bitbake
# We have a conf and classes directory, add to BBPATH
BBPATH .= ":${LAYERDIR}"

# We have recipes-* directories, add to BBFILES
BBFILES += "${LAYERDIR}/recipes-*/*/*.bb \
            ${LAYERDIR}/recipes-*/*/*.bbappend"

BBFILE_COLLECTIONS += "meta-myconfig"
BBFILE_PATTERN_meta-myconfig = "^${LAYERDIR}/"
BBFILE_PRIORITY_meta-myconfig = "6"

LAYERDEPENDS_meta-myconfig = "core"
LAYERSERIES_COMPAT_meta-myconfig = "scarthgap"
```
